// crypto_soft.c — self-contained software reference backend.
//
// SHA-256 (FIPS 180-4) and AES-128 (FIPS-197) implemented from the published
// algorithms; the K table and S-boxes are generated by
// tests/host/vgen/gen_vectors.py (exact integer cube-root construction /
// GF(2^8) + affine transform, spot-checked against published values).
//
// Used by the HOST test suite as the reference that the shipped mbedtls
// backend (src/usm/crypto_esp32.c) is later cross-checked against.
// NOT compiled into the firmware.
//
// SPDX-License-Identifier: GPL-3.0
#include "crypto.h"
#include "sha256_k.inc"
#include "aes_tables.inc"
#include <string.h>

// ===========================================================================
// SHA-256
// ===========================================================================
typedef struct {
  uint32_t h[8];      // state
  uint64_t totalBits; // message length in bits (before padding)
  uint8_t  buf[64];
  size_t   bufLen;
} sha256_soft;

static uint32_t rotr32(uint32_t x, int n) { return (x >> n) | (x << (32 - n)); }

static void sha256_block(sha256_soft* s, const uint8_t* p) {
  uint32_t w[64];
  for (int i = 0; i < 16; i++)
    w[i] = ((uint32_t)p[i * 4] << 24) | ((uint32_t)p[i * 4 + 1] << 16)
         | ((uint32_t)p[i * 4 + 2] << 8) | (uint32_t)p[i * 4 + 3];
  for (int i = 16; i < 64; i++) {
    uint32_t s0 = rotr32(w[i - 15], 7) ^ rotr32(w[i - 15], 18) ^ (w[i - 15] >> 3);
    uint32_t s1 = rotr32(w[i - 2], 17) ^ rotr32(w[i - 2], 19) ^ (w[i - 2] >> 10);
    w[i] = w[i - 16] + s0 + w[i - 7] + s1;
  }
  uint32_t a = s->h[0], b = s->h[1], c = s->h[2], d = s->h[3];
  uint32_t e = s->h[4], f = s->h[5], g = s->h[6], h = s->h[7];
  for (int i = 0; i < 64; i++) {
    uint32_t S1 = rotr32(e, 6) ^ rotr32(e, 11) ^ rotr32(e, 25);
    uint32_t ch = (e & f) ^ (~e & g);
    uint32_t t1 = h + S1 + ch + SHA256_K[i] + w[i];
    uint32_t S0 = rotr32(a, 2) ^ rotr32(a, 13) ^ rotr32(a, 22);
    uint32_t mj = (a & b) ^ (a & c) ^ (b & c);
    uint32_t t2 = S0 + mj;
    h = g; g = f; f = e; e = d + t1; d = c; c = b; b = a; a = t1 + t2;
  }
  s->h[0] += a; s->h[1] += b; s->h[2] += c; s->h[3] += d;
  s->h[4] += e; s->h[5] += f; s->h[6] += g; s->h[7] += h;
}

void crypto_sha256_init(CryptoSha256Ctx* ctx) {
  sha256_soft s = {
    {0x6A09E667, 0xBB67AE85, 0x3C6EF372, 0xA54FF53A,
     0x510E527F, 0x9B05688C, 0x1F83D9AB, 0x5BE0CD19},
    0, {0}, 0
  };
  memcpy(ctx->blob, &s, sizeof s);
}

void crypto_sha256_update(CryptoSha256Ctx* ctx, const uint8_t* in, size_t len) {
  sha256_soft* s = (sha256_soft*)&ctx->blob[0];
  s->totalBits += (uint64_t)len * 8;
  if (s->bufLen != 0) {
    size_t need = 64 - s->bufLen;
    if (len < need) { memcpy(s->buf + s->bufLen, in, len); s->bufLen += len; return; }
    memcpy(s->buf + s->bufLen, in, need);
    sha256_block(s, s->buf);
    in += need; len -= need; s->bufLen = 0;
  }
  while (len >= 64) { sha256_block(s, in); in += 64; len -= 64; }
  if (len != 0) { memcpy(s->buf, in, len); s->bufLen = len; }
}

void crypto_sha256_final(CryptoSha256Ctx* ctx, uint8_t out[32]) {
  sha256_soft* s = (sha256_soft*)&ctx->blob[0];
  uint64_t bits = s->totalBits;
  s->buf[s->bufLen++] = 0x80;
  if (s->bufLen > 56) {
    memset(s->buf + s->bufLen, 0, 64 - s->bufLen);
    sha256_block(s, s->buf);
    s->bufLen = 0;
  }
  memset(s->buf + s->bufLen, 0, 56 - s->bufLen);
  for (int i = 0; i < 8; i++)
    s->buf[56 + i] = (uint8_t)(bits >> (56 - 8 * i));
  sha256_block(s, s->buf);
  for (int i = 0; i < 8; i++) {
    out[i * 4]     = (uint8_t)(s->h[i] >> 24);
    out[i * 4 + 1] = (uint8_t)(s->h[i] >> 16);
    out[i * 4 + 2] = (uint8_t)(s->h[i] >> 8);
    out[i * 4 + 3] = (uint8_t)(s->h[i]);
  }
}

void crypto_sha256(const uint8_t* in, size_t len, uint8_t out[32]) {
  CryptoSha256Ctx c;
  crypto_sha256_init(&c);
  crypto_sha256_update(&c, in, len);
  crypto_sha256_final(&c, out);
}

// ===========================================================================
// AES-128 (FIPS-197)
// ===========================================================================
static uint8_t xtime(uint8_t a) {
  return (uint8_t)((a << 1) ^ ((a & 0x80) ? 0x1B : 0));
}

static uint8_t gf_mul(uint8_t a, uint8_t b) {
  uint8_t p = 0;
  for (int i = 0; i < 8; i++) {
    if (b & 1) p ^= a;
    a = xtime(a);
    b >>= 1;
  }
  return p;
}

static void key_expand(const uint8_t key[16], uint8_t w[176]) {
  memcpy(w, key, 16);
  uint8_t rcon = 1;
  for (int i = 4; i < 44; i++) {
    uint8_t t[4];
    memcpy(t, w + 4 * (i - 1), 4);
    if (i % 4 == 0) {
      uint8_t tmp = t[0]; t[0] = t[1]; t[1] = t[2]; t[2] = t[3]; t[3] = tmp;
      for (int j = 0; j < 4; j++) t[j] = AES_SBOX[t[j]];
      t[0] ^= rcon;
      rcon = xtime(rcon);
    }
    for (int j = 0; j < 4; j++) w[4 * i + j] = (uint8_t)(w[4 * (i - 4) + j] ^ t[j]);
  }
}

static void add_round_key(uint8_t st[16], const uint8_t* rk) {
  for (int i = 0; i < 16; i++) st[i] ^= rk[i];
}

static void sub_bytes(uint8_t st[16]) {
  for (int i = 0; i < 16; i++) st[i] = AES_SBOX[st[i]];
}

static void inv_sub_bytes(uint8_t st[16]) {
  for (int i = 0; i < 16; i++) st[i] = AES_INVSBOX[st[i]];
}

static void shift_rows(uint8_t st[16]) {
  for (int r = 1; r < 4; r++) {
    uint8_t t[4];
    for (int c = 0; c < 4; c++) t[c] = st[r + 4 * c];
    for (int c = 0; c < 4; c++) st[r + 4 * c] = t[(c + r) % 4];
  }
}

static void inv_shift_rows(uint8_t st[16]) {
  for (int r = 1; r < 4; r++) {
    uint8_t t[4];
    for (int c = 0; c < 4; c++) t[c] = st[r + 4 * c];
    for (int c = 0; c < 4; c++) st[r + 4 * c] = t[(c - r + 4) % 4];
  }
}

static void mix_columns(uint8_t st[16]) {
  for (int c = 0; c < 4; c++) {
    uint8_t a0 = st[0 + 4 * c], a1 = st[1 + 4 * c], a2 = st[2 + 4 * c], a3 = st[3 + 4 * c];
    st[0 + 4 * c] = xtime(a0) ^ (xtime(a1) ^ a1) ^ a2 ^ a3;
    st[1 + 4 * c] = a0 ^ xtime(a1) ^ (xtime(a2) ^ a2) ^ a3;
    st[2 + 4 * c] = a0 ^ a1 ^ xtime(a2) ^ (xtime(a3) ^ a3);
    st[3 + 4 * c] = (xtime(a0) ^ a0) ^ a1 ^ a2 ^ xtime(a3);
  }
}

static void inv_mix_columns(uint8_t st[16]) {
  for (int c = 0; c < 4; c++) {
    uint8_t a0 = st[0 + 4 * c], a1 = st[1 + 4 * c], a2 = st[2 + 4 * c], a3 = st[3 + 4 * c];
    st[0 + 4 * c] = gf_mul(0x0E, a0) ^ gf_mul(0x0B, a1) ^ gf_mul(0x0D, a2) ^ gf_mul(0x09, a3);
    st[1 + 4 * c] = gf_mul(0x09, a0) ^ gf_mul(0x0E, a1) ^ gf_mul(0x0B, a2) ^ gf_mul(0x0D, a3);
    st[2 + 4 * c] = gf_mul(0x0D, a0) ^ gf_mul(0x09, a1) ^ gf_mul(0x0E, a2) ^ gf_mul(0x0B, a3);
    st[3 + 4 * c] = gf_mul(0x0B, a0) ^ gf_mul(0x0D, a1) ^ gf_mul(0x09, a2) ^ gf_mul(0x0E, a3);
  }
}

void crypto_aes128_enc(const uint8_t key[16], const uint8_t in[16], uint8_t out[16]) {
  uint8_t w[176];
  key_expand(key, w);
  uint8_t st[16];
  memcpy(st, in, 16);
  add_round_key(st, w);
  for (int r = 1; r <= 9; r++) {
    sub_bytes(st);
    shift_rows(st);
    mix_columns(st);
    add_round_key(st, w + 16 * r);
  }
  sub_bytes(st);
  shift_rows(st);
  add_round_key(st, w + 160);
  memcpy(out, st, 16);
}

void crypto_aes128_dec(const uint8_t key[16], const uint8_t in[16], uint8_t out[16]) {
  uint8_t w[176];
  key_expand(key, w);
  uint8_t st[16];
  memcpy(st, in, 16);
  add_round_key(st, w + 160);
  for (int r = 9; r >= 1; r--) {
    inv_shift_rows(st);
    inv_sub_bytes(st);
    add_round_key(st, w + 16 * r);
    inv_mix_columns(st);
  }
  inv_shift_rows(st);
  inv_sub_bytes(st);
  add_round_key(st, w);
  memcpy(out, st, 16);
}